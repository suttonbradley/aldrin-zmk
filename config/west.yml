## config/west.yml
```yaml
manifest:
  remotes:
    - name: zmkfirmware
      url-base: https://github.com/zmkfirmware
    # Additional modules containing boards/shields/custom code can be listed here as well
    # See https://docs.zephyrproject.org/3.2.0/develop/west/manifest.html#projects
  projects:
    - name: zmk
      remote: zmkfirmware
      # Edit here and .github/workflows/build.yml - more here https://zmk.dev/blog/2025/06/20/pinned-zmk
      revision: v0.3-branch
      import: app/west.yml
  self:
    path: config
```
